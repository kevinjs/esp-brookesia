## examples/system/super/sdkconfig.defaults
```kconfig
CONFIG_FREERTOS_HZ=1000
CONFIG_ESP_MAIN_TASK_STACK_SIZE=4096
CONFIG_ESP_INT_WDT_TIMEOUT_MS=2000
CONFIG_ESP_TASK_WDT_TIMEOUT_S=10

CONFIG_ESP_TLS_USE_DS_PERIPHERAL=n
CONFIG_ESP_TLS_INSECURE=y
CONFIG_ESP_TLS_SKIP_SERVER_CERT_VERIFY=y
CONFIG_MBEDTLS_CERTIFICATE_BUNDLE=y
# Avoid `esp-x509-crt-bundle` error
CONFIG_MBEDTLS_CERTIFICATE_BUNDLE_DEFAULT_FULL=y
CONFIG_MBEDTLS_CERTIFICATE_BUNDLE_DEFAULT_CMN=n
CONFIG_MBEDTLS_CERTIFICATE_BUNDLE_CROSS_SIGNED_VERIFY=y

CONFIG_LWIP_FALLBACK_DNS_SERVER_SUPPORT=y
CONFIG_LWIP_DNS_SETSERVER_WITH_NETIF=y
CONFIG_MBEDTLS_EXTERNAL_MEM_ALLOC=y
CONFIG_MBEDTLS_DYNAMIC_BUFFER=y
CONFIG_MBEDTLS_SSL_KEEP_PEER_CERTIFICATE=n

# LVGL Adapter
CONFIG_ESP_LVGL_ADAPTER_ENABLE_DECODER=y
CONFIG_ESP_LVGL_ADAPTER_ENABLE_FS=y
# LVGL
CONFIG_LV_CONF_MINIMAL=y
CONFIG_LV_TXT_ENC_UTF8=y
CONFIG_LV_USE_CLIB_MALLOC=y
CONFIG_LV_USE_CLIB_STRING=y
CONFIG_LV_USE_CLIB_SPRINTF=y
CONFIG_LV_DEF_REFR_PERIOD=15
CONFIG_LV_DPI_DEF=60
CONFIG_LV_DRAW_LAYER_SIMPLE_BUF_SIZE=48000
CONFIG_LV_DRAW_SW_SHADOW_CACHE_SIZE=4
CONFIG_LV_GRADIENT_MAX_STOPS=4
CONFIG_LV_OBJ_STYLE_CACHE=y
CONFIG_LV_USE_LOG=y
CONFIG_LV_LOG_PRINTF=y
CONFIG_LV_FS_STDIO_LETTER=65
CONFIG_LV_FS_POSIX_LETTER=65
CONFIG_LV_FS_DEFAULT_DRIVER_LETTER=65
CONFIG_LV_USE_LODEPNG=y

# FreeType runtime fonts (needed for CJK text). MEMFS + LVGL port are required
# because CONFIG_SPIRAM_XIP_FROM_PSRAM is disabled in this project.
CONFIG_ESP_LVGL_ADAPTER_ENABLE_FREETYPE=y
CONFIG_LV_USE_FREETYPE=y
CONFIG_LV_FREETYPE_USE_LVGL_PORT=y
CONFIG_LV_USE_FS_MEMFS=y
CONFIG_LV_FS_MEMFS_LETTER=77

#CONFIG_BROOKESIA_GUI_INTERFACE_ENABLE_PROFILE_LOG=y
#CONFIG_BROOKESIA_SYSTEM_CORE_ENABLE_PROFILE_LOG=y
#CONFIG_BROOKESIA_APP_SETTINGS_ENABLE_PROFILE_LOG=y
#CONFIG_BROOKESIA_SYSTEM_SUPER_ENABLE_PROFILE_LOG=y
#CONFIG_BROOKESIA_GUI_INTERFACE_ENABLE_MEMORY_TRACE=y
#CONFIG_BROOKESIA_SYSTEM_HEAP_TRACE_APP_START=y

# Brookesia:Utils
CONFIG_BROOKESIA_UTILS_THREAD_PROFILER_ENABLE_FREERTOS_CONFIG=y
# Save SRAM
CONFIG_BROOKESIA_UTILS_LOG_ENABLE_FILE_AND_LINE=n
CONFIG_BROOKESIA_UTILS_LOG_ENABLE_FUNCTION_NAME=n

# Brookesia:Agent
# Coze
CONFIG_MBEDTLS_DYNAMIC_BUFFER=n
# XiaoZhi
CONFIG_XIAOZHI_AUDIO_TASK_ALLOC_DYNAMIC=y
CONFIG_XIAOZHI_STACK_IN_PSRAM=y
CONFIG_XIAOZHI_SYNC_SYSTEM_TIME_FROM_SERVER=n

# H264 (Save RAM and Flash)
CONFIG_ESP_H264_DECODER_IRAM=n
CONFIG_VIDEO_DECODER_SW_H264_SUPPORT=n
CONFIG_VIDEO_ENCODER_SW_H264_SUPPORT=n

# Audio Codec
CONFIG_AUDIO_DECODER_AAC_SUPPORT=n
CONFIG_AUDIO_DECODER_MP3_SUPPORT=y
CONFIG_AUDIO_DECODER_G711_SUPPORT=y
CONFIG_AUDIO_DECODER_AMRNB_SUPPORT=n
CONFIG_AUDIO_DECODER_AMRWB_SUPPORT=n
CONFIG_AUDIO_DECODER_FLAC_SUPPORT=n
CONFIG_AUDIO_DECODER_OPUS_SUPPORT=y
CONFIG_AUDIO_DECODER_VORBIS_SUPPORT=n
CONFIG_AUDIO_DECODER_ADPCM_SUPPORT=n
CONFIG_AUDIO_DECODER_ALAC_SUPPORT=n
CONFIG_AUDIO_DECODER_PCM_SUPPORT=y
CONFIG_AUDIO_DECODER_SBC_SUPPORT=n
CONFIG_AUDIO_DECODER_LC3_SUPPORT=n
CONFIG_AUDIO_DECODER_G722_SUPPORT=n
CONFIG_AUDIO_SIMPLE_DEC_WAV_SUPPORT=y
CONFIG_AUDIO_SIMPLE_DEC_M4A_SUPPORT=n
CONFIG_AUDIO_SIMPLE_DEC_TS_SUPPORT=n
CONFIG_AUDIO_SIMPLE_DEC_OGG_SUPPORT=n
CONFIG_AUDIO_ENCODER_AAC_SUPPORT=n
CONFIG_AUDIO_ENCODER_G711_SUPPORT=y
CONFIG_AUDIO_ENCODER_AMRNB_SUPPORT=n
CONFIG_AUDIO_ENCODER_AMRWB_SUPPORT=n
CONFIG_AUDIO_ENCODER_OPUS_SUPPORT=y
CONFIG_AUDIO_ENCODER_ADPCM_SUPPORT=n
CONFIG_AUDIO_ENCODER_ALAC_SUPPORT=n
CONFIG_AUDIO_ENCODER_PCM_SUPPORT=y
CONFIG_AUDIO_ENCODER_SBC_SUPPORT=n
CONFIG_AUDIO_ENCODER_LC3_SUPPORT=n
CONFIG_AUDIO_ENCODER_G722_SUPPORT=n

# PSRAM (ESP32-S3 8MB)
# 该方案默认会把代码段/只读数据复制进 PSRAM 以提速，但在 8MB PSRAM 上
# 单个 app 就占掉约 6.2MB，堆只剩 1.7MB，System Super 的 Shell 批量读取
# JSON 文本资源时会 std::bad_alloc 导致启动失败（表现为白屏）。
# 关闭后 PSRAM 堆恢复到约 8MB，代价是代码从 Flash 走 Cache 执行，略慢。
CONFIG_SPIRAM_FETCH_INSTRUCTIONS=n
CONFIG_SPIRAM_RODATA=n
```
